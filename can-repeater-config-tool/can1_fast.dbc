VERSION ""

NS_ :

BS_:

BU_: MotorController BMS

BO_ 256 MotorStatus: 8 MotorController
 SG_ MotorRPM : 0|16@1+ (1,0) [0|10000] "RPM" Vector__XXX
 SG_ MotorTemp : 16|8@1+ (1,-40) [-40|150] "C" Vector__XXX

BO_ 257 MotorCommands: 8 MotorController
 SG_ TorqueRequest : 0|16@1+ (0.1,0) [0|300] "Nm" Vector__XXX

BO_ 512 BMS_Status: 8 BMS
 SG_ PackVoltage : 0|16@1+ (0.1,0) [0|600] "V" Vector__XXX
 SG_ StateOfCharge : 16|8@1+ (0.5,0) [0|100] "%" Vector__XXX
